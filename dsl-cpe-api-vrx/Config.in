## ltq-voice-tapi/config/Config.in
```kconfig
#error not defined 
menu "Advanced configuration (for developers)"
	depends on PACKAGE_ltq-voice-tapi

config LTQ_VOICE_TAPI_USER_FLAGS
	depends on PACKAGE_ltq-voice-tapi
	string "Additional CFLAGS"
	default ""
	help
		Additional CFLAGS for compilation (for developers)

config LTQ_VOICE_TAPI_USER_OPTIONS
	depends on PACKAGE_ltq-voice-tapi
	string "Additional autogen configure options"
	default ""
	help
		Additional autogen configure options (for developers)


config LTQ_VOICE_TAPI_EVENT_LOGGER
	bool "Event logger support"
	depends on PACKAGE_ltq-voice-tapi && +PACKAGE_ltq-evtlog
	default n
	help
		Option to capture detailed traces via the event logger module.
		- for debugging only
		- requires package ltq-evtlog.

config LTQ_VOICE_TAPI_DEBUGGING
	bool "Debugging support"
	depends on PACKAGE_ltq-voice-tapi
	default n
	help
		Option to support debugging:
		- disable compile optimisation
		- set the default trace-level to "debug"
		- enable ASSERT

endmenu

config LTQ_VOICE_TAPI_FAX
	bool "FAX relay and modem support"
	depends on PACKAGE_ltq-voice-tapi
	depends on PACKAGE_ltq-voice-vmmc || PACKAGE_ltq-voice-vmmc-xrx500 || PACKAGE_ltq-voice-vmmc-grx750 
	default y
	help
		Option to enable fax/modem support in TAPI.

config LTQ_VOICE_TAPI_CID
	bool "CID support"
	depends on PACKAGE_ltq-voice-tapi
	depends on PACKAGE_ltq-voice-vmmc || PACKAGE_ltq-voice-vmmc-xrx500 || PACKAGE_ltq-voice-duslic_xs
	default y
	help
		Option to enable Caller ID support.

config LTQ_VOICE_TAPI_LT_GR909
	bool "Linetesting GR-909 support"
	depends on PACKAGE_ltq-voice-tapi
	depends on PACKAGE_ltq-voice-vmmc || PACKAGE_ltq-voice-vmmc-xrx500 || PACKAGE_ltq-voice-duslic_xs
	default y
	help
		Option to enable GR-909 linetesting support.

config LTQ_VOICE_TAPI_CONT_MEASUREMENT
	bool "Continuous Analog Line Measurement"
	depends on PACKAGE_ltq-voice-tapi
	depends on PACKAGE_ltq-voice-vmmc || PACKAGE_ltq-voice-vmmc-xrx500 || PACKAGE_ltq-voice-duslic_xs
	default y
	help
		Option to enable continuous measurement on FXS lines.

config LTQ_VOICE_TAPI_CAP_MEASUREMENT
	bool "Capacitance Analog Line Measurement"
	depends on PACKAGE_ltq-voice-tapi
	depends on PACKAGE_ltq-voice-vmmc || PACKAGE_ltq-voice-vmmc-xrx500 || PACKAGE_ltq-voice-duslic_xs
	default y
	help
		Option to enable capacitance measurement on FXS lines.

config LTQ_VOICE_TAPI_DECT
	bool "DECT encoding for COSIC modem"
	depends on PACKAGE_ltq-voice-tapi
	depends on PACKAGE_ltq-voice-vmmc || PACKAGE_ltq-voice-vmmc-xrx500
	select LTQ_VOICE_TAPI_KPI
	default y
	help
		Option to enable DECT encoding for COSIC modem.

config LTQ_VOICE_TAPI_QOS
	bool "QOS for accelerated RTP packet handling"
	depends on PACKAGE_ltq-voice-tapi
	depends on PACKAGE_ltq-voice-vmmc || PACKAGE_ltq-voice-vmmc-xrx500 || PACKAGE_ltq-voice-kpi2udp
	select LTQ_VOICE_TAPI_KPI
	default y
	help
		Option to enable an accelerated RTP packet transfer inside
		the LINUX kernel space. This option requires the KPI2UDP
		packet, which actually provides the OS specific hooks in
		the IP stack.

config LTQ_VOICE_TAPI_KPI
	bool "KPI (Kernel Packet Interface)"
	depends on PACKAGE_ltq-voice-tapi
	depends on PACKAGE_ltq-voice-vmmc || PACKAGE_ltq-voice-vmmc-xrx500 || PACKAGE_ltq-voice-kpi2udp
	default y
	help
		Option to enable the generic kernel level packet interface
		which allows accelerated packet transfer for various purposes.
		The most important example is the QOS option, which allows
		to redirect RTP packets directly into the IP stack.
		Other options relying on KPI are DECT and HDLC.

config LTQ_VOICE_TAPI_STATISTICS
	bool "Voice packet counters in procfs"
	depends on PACKAGE_ltq-voice-tapi
	depends on PACKAGE_ltq-voice-vmmc || PACKAGE_ltq-voice-vmmc-xrx500
	default y
	help
		Option to enable packet counters which can be read via the
		procfs "statistic" node.

config LTQ_VOICE_TAPI_METERING
	bool "Metering (TTX) support"
	depends on PACKAGE_ltq-voice-tapi
	depends on PACKAGE_ltq-voice-vmmc || PACKAGE_ltq-voice-vmmc-xrx500 || PACKAGE_ltq-voice-duslic_xs
	default y
	help
		Option to enable metering (TTX) support.

config LTQ_VOICE_TAPI_PCM
	bool "PCM support"
	depends on PACKAGE_ltq-voice-tapi
	depends on PACKAGE_ltq-voice-vmmc || PACKAGE_ltq-voice-vmmc-xrx500 || PACKAGE_ltq-voice-duslic_xs || PACKAGE_ltq-voice-vmmc-grx750 
	default y
	help
		Option to enable the PCM interface support.

#config LTQ_VOICE_TAPI_HDLC
#	bool "PCM HDLC support (evaluation)"
#	depends on PACKAGE_ltq-voice-tapi
#	select LTQ_VOICE_TAPI_PCM
#	default n
#	help
#		Option to enable PCM HDLC framing inside the firmware
#		for ISDN D-Channel access.

config LTQ_VOICE_TAPI_PHONE_DETECTION
	bool "FXS Phone Detection"
	depends on PACKAGE_ltq-voice-tapi
	depends on PACKAGE_ltq-voice-vmmc || PACKAGE_ltq-voice-vmmc-xrx500 || PACKAGE_ltq-voice-duslic_xs
	default n
	help
		Enable the Phone Detection feature on FXS lines.

config LTQ_VOICE_TAPI_PMC
	bool "Register with Power Management Control Unit"
	depends on PACKAGE_ltq-voice-tapi
	default n
	help
		Register with the Power Management Control Unit (PMCU)
		for enable/disable of the power save features and status
		reports of voice-FW activity.

config LTQ_VOICE_TAPI_HOTPLUG
	bool "Enable Linux hotplug events"
	depends on PACKAGE_ltq-voice-tapi
	default n
	help
		Enable support for Linux hotplug event feature.

config LTQ_VOICE_TAPI_TRACES
	bool "Compile with driver traces"
	depends on PACKAGE_ltq-voice-tapi
	default n
	help
		Enable driver trace printout with different trace levels to be
		configured dynamically from the application or during insmod

config LTQ_VOICE_TAPI_SRTP
	depends on PACKAGE_ltq-voice-tapi
	depends on PACKAGE_ltq-voice-vmmc-xrx500
	select PACKAGE_kmod-libsrtp-km
	bool "SRTP support"
	default n
	help
		Option to build SRTP support in TAPI

config LTQ_VOICE_TAPI_KERNEL_MODULE
	depends on PACKAGE_ltq-voice-tapi
	bool "Build kernel module"
	default y
	help
		Option to enable building of kernel module
```

## ltq-voice-vmmc-xrx500-coef/config/Config.in
```kconfig
choice
   depends on PACKAGE_ltq-voice-vmmc-xrx500-coef
   prompt "FXS coefficients"
   default LTQ_VOICE_VMMC_COEF_XRX500_ETSI
   help
      Select country specific BBD coefficient file.

   config LTQ_VOICE_VMMC_COEF_XRX500_ETSI
      bool "ETSI (FXS: T3R10, Vl:40V, Ic:25mA, Vid:25V, Vri:45Vrms, f:25Hz) (FXO: T0R0)"
      help
        These coefficents contains a parameter set with line impedance Zr according to ETSI.

        T:   gain in transmit direction (attenuation in dBr) [dBr]
        R:   gain in receive direction (attenuation in dBr) [dBr]
        Vl:  on-hook voltage limit [V]
        Ic:  off-hook loop current [mA]
        Vid: low-power-standby voltage [V]
        Vri: ring voltage [v]
        f:   ring frequency [V]

   config LTQ_VOICE_VMMC_COEF_XRX500_US600R
      bool "USA 600R (FXS: T3R10, Vl:40V, Ic:25mA, Vid:25V, Vri:45Vrms, f:25Hz) (FXO: T0R0)"
      help
        These coefficents contains a parameter set with line impedance e.g. for USA.

        T:   gain in transmit direction (attenuation 3dBr) [dBr]
        R:   gain in receive direction (attenuation 10dBr) [dBr]
        Vl:  on-hook voltage limit [V]
        Ic:  off-hook loop current [mA]
        Vid: low-power-standby voltage [V]
        Vri: ring voltage [v]
        f:   ring frequency [V]

   config LTQ_VOICE_VMMC_COEF_XRX500_GERMANY
      bool "Germany (FXS: T3R10, Vl:40V, Ic:25mA, Vid:25V, Vri:45Vrms, f:25Hz) (FXO: T0R0)"
      help
        These coefficents contains a parameter set with line impedance for Germany.

        T:   gain in transmit direction (attenuation 3dBr) [dBr]
        R:   gain in receive direction (attenuation 10dBr) [dBr]
        Vl:  on-hook voltage limit [V]
        Ic:  off-hook loop current [mA]
        Vid: low-power-standby voltage [V]
        Vri: ring voltage [v]
        f:   ring frequency [V]

   config LTQ_VOICE_VMMC_COEF_XRX500_USE_CUSTOM_FILE
      bool "Select own FXS coefficient file"
endchoice

menu "FXS own coefficient file"
   depends on PACKAGE_ltq-voice-vmmc-xrx500-coef
   depends on LTQ_VOICE_VMMC_COEF_XRX500_USE_CUSTOM_FILE

   config LTQ_VOICE_VMMC_COEF_XRX500_CUSTOM_FILE_FXS
   depends on PACKAGE_ltq-voice-vmmc-xrx500-coef
   depends on LTQ_VOICE_VMMC_COEF_XRX500_USE_CUSTOM_FILE
   string "FXS own coefficient file"
   help
     Custom file to be used as BBD file. This can be either a BBD file as created by the XTCOS tool
     or an BBD archive containing multiple BBD files for different DC/DC types and SLIC versions.
     Specify the absolute path and filename of the file.

endmenu

menu "FXO own coefficient file"
   depends on PACKAGE_ltq-voice-vmmc-xrx500-coef
   depends on LTQ_VOICE_VMMC_COEF_XRX500_USE_CUSTOM_FILE

   config LTQ_VOICE_VMMC_COEF_XRX500_CUSTOM_FILE_FXO
   depends on PACKAGE_ltq-voice-vmmc-xrx500-coef
   depends on LTQ_VOICE_VMMC_COEF_XRX500_USE_CUSTOM_FILE
   string "FXO own coefficient file"
   help
     Custom file to be used as BBD file. This can be either a BBD file as created by the XTCOS tool
     or an BBD archive containing multiple BBD files for different DC/DC types and SLIC versions.
     Specify the absolute path and filename of the file.

endmenu
```

## ltq-voice-vmmc-xrx500/config/Config.in
```kconfig
menu "advanced configuration (for developers)"
	depends on PACKAGE_ltq-voice-vmmc-xrx500

config LTQ_VOICE_VMMC_USER_FLAGS
	depends on PACKAGE_ltq-voice-vmmc-xrx500
	string "Additional CFLAGS"
	default ""
        help
                Additional CFLAGS for compilation (for developers)

config LTQ_VOICE_VMMC_USER_OPTIONS
	depends on PACKAGE_ltq-voice-vmmc-xrx500
	string "Additional autogen configure options"
        default ""
        help
                Additional autogen configure options (for developers)

config LTQ_VOICE_VMMC_DEBUGGING
	depends on PACKAGE_ltq-voice-vmmc-xrx500
	bool "Debugging support"
	default n
	help
		Option to support debugging:
		- disable compile optimisation
		- set the default trace-level to "debug"
		- enable ASSERT

config LTQ_VOICE_VMMC_MPS_HISTORY_SIZE
	depends on PACKAGE_ltq-voice-vmmc-xrx500
	string "MPS history buffer in words (0<=size<=512)"
	default "128"
	help
		MPS history buffer (default=128 words, maximum=512 words, 0=disable)
		To opimize the memory footprint in RAM, you might want to set the
		buffer size to 0.
endmenu

choice
	depends on PACKAGE_ltq-voice-vmmc-xrx500
	prompt "device selection"
	default LTQ_VOICE_VMMC_WITH_DEVICE_XRX500 if (TARGET_intel_mips_xrx500 || TARGET_lantiq_xrx500)
	help
		Select the target device.

	config LTQ_VOICE_VMMC_WITH_DEVICE_XRX500
		bool "xRX500 family"
		select PACKAGE_ltq-voice-vmmc-xrx500-firmware
		select PACKAGE_ltq-voice-vmmc-xrx500-coef  if (!PACKAGE_ltq-voice-tapi-lib-country)
endchoice

choice
	depends on PACKAGE_ltq-voice-vmmc-xrx500
	prompt "SLIC selection"
	default LTQ_VOICE_VMMC_WITH_SLIC100

	config LTQ_VOICE_VMMC_WITH_SLIC_NONE
		help
			Option to disable all SLIC support. This removes all FXS port
			support from the driver and frees the GPIOs which are otherwise used
			by the SSI interface that connects the SLIC to the SOC.
			The DSP functions of the voice subsystem remain unaffected by this.
			This configuration is intended for systems providing DECT voice
			service using the Cosic chipset but also for other voice services
			like DUSLIC-xT or DUSLIC XS which are connected via the PCM interface.
		bool "no SLIC support"

	config LTQ_VOICE_VMMC_WITH_SLIC100
		help
			Support the XWAY(TM) SLIC 100 chipset family devices.
		bool "SLIC 100"
		select PACKAGE_ltq-voice-sdd-mbx

	config LTQ_VOICE_VMMC_WITH_SLIC200
		help
			Support the SLIC 200 family devices.
		bool "SLIC 200"
		select PACKAGE_ltq-voice-sdd-mbx
endchoice

config LTQ_VOICE_VMMC_FXO
	depends on PACKAGE_ltq-voice-vmmc-xrx500
	depends on LTQ_VOICE_VMMC_WITH_SLIC100
	bool "FXO support"
	default y
	help
		Option to enable support for the FXO functionality.

config LTQ_VOICE_VMMC_SSLIC_FXO_ACTIVATE
	depends on PACKAGE_ltq-voice-vmmc-xrx500
	depends on LTQ_VOICE_VMMC_FXO
	bool "Activate SmartSLIC FXO ports upon TAPI init"
	default n
	help
		Option to activate FXO ports connected to a SmartSLIC by default.
                This should be disabled unless there is an FXO chip connected to
                the GPIOs of the SmartSLIC. Otherwise the SmartSLIC may consume
                quite some processor power depending on the signals on the GPIO pins
                of the SmartSLIC.
                Do not set for the LANTIQ xRX500 Family boards.

config LTQ_VOICE_VMMC_DISABLE_DECT_NIBBLE_SWAP
	depends on PACKAGE_ltq-voice-vmmc-xrx500
	bool "disable DECT nibble swap"
	default n
	help
		Option to disable DECT nibble swap for COSIC modem.
		This is only needed for backward compatibility.

config LTQ_VOICE_VMMC_RTCP_XR
	depends on PACKAGE_ltq-voice-vmmc-xrx500
	bool "RTCP Extended Reports support"
	default y
	help
		Option to enable support for the RTCP Extended Reports (RFC3611) functionality.

config LTQ_VOICE_VMMC_DISABLE_AUTO_DATA_MAP
	depends on PACKAGE_ltq-voice-vmmc-xrx500
	bool "Disable automatic data channel to data channel connections"
	default n
	help
		Option to disable the automatic connection between data channels
		which are connected to the same Phone, DECT or PCM module.
		When the automatic mapping is disabled the IOCTLs IFX_TAPI_MAP_DATA_ADD
		and IFX_TAPI_MAP_DATA_REMOVE can be used to create data channel to
		data channel mappings. This allows to create connections between data
		channels without using a Phone, DECT or PCM module. Data channels can
		even be connected to itself which results in a decoding/encoding module
		for one RTP stream only.
```
