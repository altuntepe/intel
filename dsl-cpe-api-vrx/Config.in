## dsl-cpe-api-vrx/Config.in
```kconfig
menu "Configuration"
	depends on PACKAGE_dsl-cpe-api-vrx

	choice
		prompt "Build Model"
		default dsl-cpe-api-vrx_MODEL_FULL
		help
		  Selection of a model (predefined combination of configure options).

	config dsl-cpe-api-vrx_MODEL_LITE
		bool "Lite"
		help
		  Minimum features included.
		  This model should ONLY demonstrate the minimum possible size.

	config dsl-cpe-api-vrx_MODEL_FOOTPRINT
		bool "Footprint"
		help
		  Defined for low footprint applications.

	config dsl-cpe-api-vrx_MODEL_TYPICAL
		bool "Typical"
		help
		  Defined for most typical use.

	config dsl-cpe-api-vrx_MODEL_FULL
		bool "Full"
		help
		  Includes all features but NOT all debug functionalities.

	config dsl-cpe-api-vrx_MODEL_DEBUG
		bool "Debug"
		help
		  Includes all features AND debug functionalities.
	endchoice

	menu "optional build options"
		depends on PACKAGE_dsl-cpe-api-vrx
	config dsl-cpe-api-vrx_USE_ADDITIONAL_BUILD_OPTIONS
		depends on PACKAGE_dsl-cpe-api-vrx
		bool "Use additional build options"
		default n
		help
		  Provides the possibility to include/exclude single features directly.
		  This configuration overwrites selections which are done by the "build model" configuration.

	config dsl-cpe-api-vrx_ADDITIONAL_BUILD_OPTIONS
		depends on dsl-cpe-api-vrx_USE_ADDITIONAL_BUILD_OPTIONS
		string "Additional build options"
		help
		  Defines to include/exclude single feature using available configure options.
		  Please refer to the documentation of the DSL CPE API "Configure options for the DSL CPE API"
	endmenu

	menu "Additional external driver c-flags"
 	config dsl-cpe-api-vrx_USE_DSL_ADD_EXT_DRV_CFLAGS
		depends on PACKAGE_dsl-cpe-api-vrx
		bool "Use additional external driver c-flags"
		default n
		help
		  Defines additional external driver c-flags.
		  For example platform specific and selected by the buildbot.

	config dsl-cpe-api-vrx_DSL_ADD_EXT_DRV_CFLAGS
		depends on dsl-cpe-api-vrx_USE_DSL_ADD_EXT_DRV_CFLAGS
		string "Additional external driver c-flags"
		help
		  Defines additional external driver c-flags.
		  For example platform specific and selected by the buildbot.
	endmenu
endmenu
```

## dsl-cpe-control-vrx/Config.in
```kconfig
menu "Configuration"
	depends on PACKAGE_dsl-cpe-control-vrx

	config dsl-cpe-control-vrx_DTI
		bool "Include DTI"
		select PACKAGE_lib-dti
		default n
		help
		  Defines to include/exclude the Debug & Trace Interface.

	choice
		prompt "Build Model"
		default dsl-cpe-control-vrx_MODEL_FOOTPRINT
		help
		  Selection of a model (predefined combination of configure options).

	config dsl-cpe-control-vrx_MODEL_LITE
		bool "Lite"
		help
		  Minimum features included.
		  This model should ONLY demonstrate the minimum possible size.

	config dsl-cpe-control-vrx_MODEL_FOOTPRINT
		bool "Footprint"
		select dsl-cpe-control-vrx_DTI
		help
		  Defined for low footprint applications.

	config dsl-cpe-control-vrx_MODEL_TYPICAL
		bool "Typical"
		select dsl-cpe-control-vrx_DTI
		help
		  Defined for most typical use.

	config dsl-cpe-control-vrx_MODEL_FULL
		bool "Full"
		select dsl-cpe-control-vrx_DTI
		help
		  Includes all features but NOT all debug functionalities.

	config dsl-cpe-control-vrx_MODEL_DEBUG
		bool "Debug"
		select dsl-cpe-control-vrx_DTI
		help
		  Includes all features AND debug functionalities.
	endchoice

	menu "optional build options"
		depends on PACKAGE_dsl-cpe-control-vrx
	config dsl-cpe-control-vrx_USE_ADDITIONAL_BUILD_OPTIONS
		bool "Use additional build options"
		default n
		help
		  Provides the possibility to include/exclude single features directly.
		  This configuration overwrites selections which are done by the "build model" configuration.

	config dsl-cpe-control-vrx_ADDITIONAL_BUILD_OPTIONS
		depends on dsl-cpe-control-vrx_USE_ADDITIONAL_BUILD_OPTIONS
		string "Additional build options"
		help
		  Defines to include/exclude single feature using available configure options.
		  Please refer to the documentation of the DSL CPE API "Configure options for the DSL CPE API"
	endmenu

	menu "Additional external control application c-flags"
 	config dsl-cpe-control-vrx_USE_DSL_ADD_EXT_APPL_CFLAGS
		depends on PACKAGE_dsl-cpe-control-vrx
		bool "Use additional external control application c-flags"
		default n
		help
		  Defines additional external control application c-flags.
		  For example platform specific and selected by the buildbot.

	config dsl-cpe-control-vrx_DSL_ADD_EXT_APPL_CFLAGS
		depends on dsl-cpe-control-vrx_USE_DSL_ADD_EXT_APPL_CFLAGS
		string "Additional external control application c-flags"
		help
		  Defines additional external control application c-flags.
		  For example platform specific and selected by the buildbot.
	endmenu
endmenu
```

## dsl-cpe-fapi/Config.in
```kconfig
menu "Configuration"
	depends on PACKAGE_dsl-cpe-fapi

	config dsl-cpe-fapi_FAPI_DAEMON
		bool "Support CLI application"
		default n
endmenu
```

## dsl-cpe-mei-vrx/Config.in
```kconfig
menu "Configuration"
	depends on PACKAGE_dsl-cpe-mei-vrx

	choice
		prompt "Device selection"
		default dsl-cpe-mei-vrx_DEVICE_VR9
		help
		  Selection of a device.

	config dsl-cpe-mei-vrx_DEVICE_VR9
		bool "VRX200"
		help
		  Actiavtes build for VRX200 Family.

	config dsl-cpe-mei-vrx_DEVICE_VR10
		bool "VRX300"
		help
		  Actiavtes build for VRX300 Family.

	config dsl-cpe-mei-vrx_DEVICE_VR10_320
		bool "VRX320"
		help
		  Actiavtes build for VRX300 Family, VRX320 Subfamily.

	config dsl-cpe-mei-vrx_DEVICE_VR11
		bool "VRX500"
		help
		  Actiavtes build for VRX500 Family.

	endchoice

	choice
		prompt "Build Model"
		default dsl-cpe-mei-vrx_MODEL_DEBUG
		help
		  Selection of a build model for the VRX MEI Driver.

	config dsl-cpe-mei-vrx_MODEL_RELEASE
		bool "Release"
		help
		  Excludes debug functionalities and symbols.

	config dsl-cpe-mei-vrx_MODEL_DEBUG
		bool "Debug"
		help
		  Includes all debug functionalities and symbols.
	endchoice

	menu "Additional external driver c-flags"
 	config dsl-cpe-mei-vrx_USE_MEI_ADD_EXT_DRV_CFLAGS
		depends on PACKAGE_dsl-cpe-mei-vrx
		bool "Use additional external driver c-flags"
		default n
		help
		  Defines additional external driver c-flags.
		  For example platform specific and selected by the buildbot.

	config dsl-cpe-mei-vrx_MEI_ADD_EXT_DRV_CFLAGS
		depends on dsl-cpe-mei-vrx_USE_MEI_ADD_EXT_DRV_CFLAGS
		string "Additional external driver c-flags"
		help
		  Defines additional external driver c-flags.
		  For example platform specific and selected by the buildbot.
	endmenu

	config dsl-cpe-mei-vrx_USE_KERNEL_BUILD_IN
		bool "Use kernel build-in"
		default n

	config dsl-cpe-mei-vrx_USE_PCI_SLAVE_DOWNLOAD
		bool "Use PCI Slave firmware download"
		default n

	config dsl-cpe-mei-vrx_MEI_PREDEF_DBG_BAR
		bool "Enable BAR debug user functionality"
		default y

	config dsl-cpe-mei-vrx_MEI_DEBUG_STREAM_SUPPORT
		bool "Enable Debug stream support functionality"
		default y

	choice
		prompt "Debug & Test mode"
		default dsl-cpe-mei-vrx_DTM_NONE
		help
		  Configures the MEI Driver to operate in a specific debug or test mode.

	config dsl-cpe-mei-vrx_DTM_NONE
		bool "None (normal operation)"
		help
		  Do not use any specific debug or test mode (default)

	config dsl-cpe-mei-vrx_DTM_EMULATION
		bool "Emulation"
		help
		  Selects (pre-silicon) emulation related configuration and operation mode.

	config dsl-cpe-mei-vrx_DTM_STANDALONE
		bool "Standalone"
		help
		  Selects standalone operation mode for DSL Subsystem.
		  1) If DSL CPE API (dsl-cpe-api-vrx) is NOT included the DSL Subsystem is initialized
		     by the MEI Driver during system boot in a very basic way (just FW download, no
		     xDSL multimode capability etc.)
		     This mode is useful for system bringup purpose for example.
		  2) If DSL CPE API (dsl-cpe-api-vrx) is additionally included the DSL Subsystem is
		     initialized by standard OpenWRT boot procedure but without higher layer, such
		     like DSL-FAPI and DSL-SL.
		     Full functionality will be available on DSL CPE PHY subsystem level in this case.

	endchoice

	choice
		prompt "IRQ Polling mode"
		default dsl-cpe-mei-vrx_IRQ_POLLING_ACTIVE if dsl-cpe-mei-vrx_DEVICE_VR10_320
		default dsl-cpe-mei-vrx_IRQ_NORMAL
		help
		  Change the IRQ mode.

	config dsl-cpe-mei-vrx_IRQ_NORMAL
		bool "Normal IRQ mode"
		help
		  Uses the normal IRQs received from the device tree or from
		  the PCIe enpoint driver.

	config dsl-cpe-mei-vrx_IRQ_POLLING_PASSIVE
		bool "Passive IRQ polling mode"
		help
		  Instead of using the IRQ provided by the PCIe Endpoint
		  driver or by the device tree, use passive IRQ polling mode. (0)
		  ATTENTION:
		  In case of using the MEI Driver standalone operation, means there are
		  no SW layers used above, which are frequently sending DSL Firmware
		  messages this configuration must be avoided. In this case it is strictly
		  recommended to select active polling instead.

	config dsl-cpe-mei-vrx_IRQ_POLLING_ACTIVE
		bool "Active IRQ polling mode"
		help
		  Instead of using the IRQ provided by the PCIe Endpoint
		  driver or by the device tree, use active IRQ polling mode. (99)

	endchoice

	choice
		depends on dsl-cpe-mei-vrx_USE_PCI_SLAVE_DOWNLOAD
		prompt "PCI Slave address range"
		default dsl-cpe-mei-vrx_USE_PCI_SLAVE_ADDR_RANGE_ADTRAN
	config dsl-cpe-mei-vrx_USE_PCI_SLAVE_ADDR_RANGE_ADTRAN
		bool "ADTRAN"
	config dsl-cpe-mei-vrx_USE_PCI_SLAVE_ADDR_RANGE_BONDING
		bool "BONDING"
    	endchoice

	config dsl-cpe-mei-vrx_DSL_NETLINK_ID
		depends on PACKAGE_dsl-cpe-logger
		string
		prompt "Netlink ID for debug messages"
		default "28"
		help
		  Defines Netlink ID number for the debug message channel.

	choice
		prompt "PPA Version"
		default dsl-cpe-mei-vrx_PPA_WITHOUT_TC_CB if (dsl-cpe-mei-vrx_DEVICE_VR10_320)
		default dsl-cpe-mei-vrx_PPA_WITH_TC_CB
		help
		  Choose which version of PPA subsystem this should be built against.

	config dsl-cpe-mei-vrx_PPA_NO
		bool "Without PPA support"
		help
		  With this option the driver will not call any PPA functions
		  and will operate independently of PPA. With this mode traffic
		  will probably not work. Do not use this in normal cases.

	config dsl-cpe-mei-vrx_PPA_WITHOUT_TC_CB
		bool "With PPA < 3.3 support"
		help
		  This will use the PPA subsystem, but it will not use the TC
		  callbacks. This is needed for PPA version older than
		  version 3.3.

	config dsl-cpe-mei-vrx_PPA_WITH_TC_CB
		bool "With PPA >= 3.3 support"
		help
		  This will use the PPA subsystem with the TC callbacks.
		  This should be used with PPA subsystem >= 3.3.

	endchoice
endmenu
```

## ifxos/config/Config.in
```kconfig
config IFXOS_IPV6_SUPPORT
	bool "IPv6 support"
	default n
	help
		Option to enable IPv6 support

config IFXOS_SHARED_LIB
	bool "IFXOS as shared library"
	help
		Provide IFXOS also as shared library
```

## lib-dti/config/Config.in
```kconfig
config COMMON_DTI_ERROR_PRINTS
	bool
	prompt "Enable error output"
	default y

config COMMON_DTI_TCP_IP_PORT
	int
	prompt "Default TCP/IP port"
	default 9000

config COMMON_DTI_CLI
	bool
	prompt "Build and add the DTI CLI Feature"
	default y

config COMMON_DTI_STATISTICS
	bool
	prompt "Build and add the DTI CORE Statistics"
	default n

config COMMON_DTI_STANDALONE
	bool
	prompt "Build and install the DTI Standalone Agent"
	default y

config COMMON_DTI_GENERIC_DEVICE
	bool
	prompt "Build and add the DTI Generic Device"
	default y

config COMMON_DTI_CLIENT_LIB
	bool
	prompt "Build and add the DTI Client Library"
	default n
```

## ltq-voice-sdd-mbx/config/Config.in
```kconfig
menu "Advanced configuration (for developers)"
	depends on PACKAGE_ltq-voice-sdd-mbx

config LTQ_VOICE_SDD_MBX_USER_FLAGS
	depends on PACKAGE_ltq-voice-sdd-mbx
	string "Additional CFLAGS"
	default ""
	help
		Additional CFLAGS for compilation (for developers)

config LTQ_VOICE_SDD_MBX_USER_OPTIONS
	depends on PACKAGE_ltq-voice-sdd-mbx
	string "Additional configure options"
	default ""
	help
		Additional configure options (for developers)

config LTQ_VOICE_SDD_MBX_EVENT_LOGGER
	depends on PACKAGE_ltq-voice-sdd-mbx
	depends on +PACKAGE_ltq-evtlog
	bool "event logger support"
	default n
	help
		Option to send traces from Tapidemo to Event Logger
		- for debugging only
		- requires package ltq-evtlog

config LTQ_VOICE_SDD_MBX_DEBUGGING
	bool "Debugging support"
	depends on PACKAGE_ltq-voice-sdd-mbx
	default n
	help
		Option to support debugging:
		- disable compile optimisation
		- set the default trace-level to "debug"
		- enable ASSERT

endmenu
```
